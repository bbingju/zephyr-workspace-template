## app/west.yml
```yaml
manifest:
  version: "1.0"
  defaults:
    remote: zephyrproject
  remotes:
    - name: zephyrproject
      url-base: https://github.com/zephyrproject-rtos
  projects:
    - name: zephyr
      repo-path: zephyr
      revision: "v3.4.0"
      import:
        path-prefix: deps
  self:
    path: app
```
